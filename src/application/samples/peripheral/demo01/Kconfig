## src/application/samples/peripheral/demo01/Kconfig
```kconfig
config DEMO01_VEHICLE_END
    bool "DEMO01 Vehicle End (ALL)"
    default y
    help
        Vehicle end with PWM servo, vibration sensor, WiFi STA, SLE Server.
```

## src/application/samples/peripheral/demo02/Kconfig
```kconfig
config DEMO02_MOBILE_END
    bool "DEMO02 Mobile End (ALL)"
    default y
    help
        Mobile end with OLED, key interrupt, buzzer, WiFi SoftAP, SLE Client.
```
